## boards/shields/nickey44a/dts/bindings/behaviors/zmk,behavior-peripheral-invoke.yaml
```yaml
description: >
  Invoke a source-local behavior (e.g. &bootloader) on a fixed split
  peripheral, regardless of where the triggering key or combo came from.

compatible: "zmk,behavior-peripheral-invoke"

include: zero_param.yaml

properties:
  bindings:
    type: phandle-array
    required: true
    description: The single behavior binding to invoke on the peripheral.
  peripheral:
    type: int
    default: 0
    description: Split peripheral index (0 = first peripheral).
```

## boards/shields/nickey44a/dts/bindings/input/processor/input-processor-circle-keys.yaml
```yaml
description: Tap a ZMK keycode for each step of circular one-finger motion
compatible: "zmk,input-processor-circle-keys"
include: ip_zero_param.yaml
properties:
  x-code:
    type: int
    required: true
  y-code:
    type: int
    required: true
  touch-code:
    type: int
    required: true
  segment-distance:
    type: int
    default: 12
    description: Positive motion length, in REL units, accumulated into one direction segment.
  step-degrees:
    type: int
    default: 45
    description: Positive accumulated turning angle per keycode tap.
  max-turn-degrees:
    type: int
    default: 90
    description: A larger turn between two segments is treated as a corner or jitter and ignored.
  idle-reset-ms:
    type: int
    default: 200
    description: Motion gap after which direction history restarts.
  clockwise-keycode:
    type: int
    required: true
    description: Encoded ZMK keycode tapped per clockwise step (X right, Y down).
  counterclockwise-keycode:
    type: int
    required: true
```

## boards/shields/nickey44a/dts/bindings/input/processor/input-processor-pinch-keys.yaml
```yaml
description: Turns TPS43 pinch (zoom gesture) motion into modifier + vertical wheel (Option+scroll zoom)
compatible: "zmk,input-processor-pinch-keys"
include: ip_zero_param.yaml
properties:
  zoom-code:
    type: int
    required: true
    description: Relative code carrying the driver's signed zoom amount (INPUT_REL_MISC).
  step:
    type: int
    default: 30
    description: Zoom units (permille of pad width) per wheel tick. Larger means slower zoom.
  modifier-keycode:
    type: int
    required: true
    description: Encoded ZMK keycode held while pinching (LALT for macOS Option).
  invert-wheel:
    type: boolean
    description: Send wheel down for fingers apart instead of wheel up.
```

## boards/shields/nickey44a/dts/bindings/input/processor/input-processor-touch-swipe.yaml
```yaml
# Bundled binding mirror; keep identical to the standalone touch-swipe binding.
description: One horizontal or vertical swipe per complete touch, with configurable ZMK keycodes
compatible: "zmk,input-processor-touch-swipe"
include: ip_zero_param.yaml
properties:
  hwheel-code:
    type: int
    required: true
  wheel-code:
    type: int
    required: true
  touch-code:
    type: int
    required: true
  threshold:
    type: int
    default: 8
    description: Positive minimum net horizontal wheel units.
  axis-ratio:
    type: int
    default: 2
    description: Positive horizontal magnitude to total vertical travel ratio.
  left-keycode:
    type: int
    required: true
    description: Encoded ZMK keycode tapped on a negative horizontal swipe.
  right-keycode:
    type: int
    required: true
    description: Encoded ZMK keycode tapped on a positive horizontal swipe.
  up-keycode:
    type: int
    description: Optional encoded ZMK keycode tapped on a positive vertical (WHEEL) swipe.
  down-keycode:
    type: int
    description: Optional encoded ZMK keycode tapped on a negative vertical (WHEEL) swipe.
  vertical-threshold:
    type: int
    description: Positive minimum net vertical wheel units; defaults to threshold.
```

## dts/bindings/input/processor/input-processor-pinch-keys.yaml
```yaml
description: Turns TPS43 pinch (zoom gesture) motion into held modifier/mouse button + vertical wheel
compatible: "zmk,input-processor-pinch-keys"
include: ip_zero_param.yaml
properties:
  zoom-code:
    type: int
    required: true
    description: Relative code carrying the driver's signed zoom amount (INPUT_REL_MISC).
  step:
    type: int
    default: 30
    description: Zoom units (permille of pad width) per wheel tick. Larger means slower zoom.
  modifier-keycode:
    type: int
    description: Encoded ZMK keycode held while pinching (e.g. LALT). Optional.
  hold-buttons:
    type: int
    description: Mouse button flags held while pinching (e.g. MB5, as LalaPad Gen2). Optional.
  invert-wheel:
    type: boolean
    description: Send wheel down for fingers apart instead of wheel up.
```

## dts/bindings/input/processor/input-processor-three-finger-swipe.yaml
```yaml
description: One four-way three-finger swipe or tap per complete touch, with configurable ZMK keycodes
compatible: "zmk,input-processor-three-finger-swipe"
include: ip_zero_param.yaml
properties:
  touch-code:
    type: int
    required: true
  left-code:
    type: int
    required: true
    description: Input key code the driver reports for one physically leftward sample.
  right-code:
    type: int
    required: true
  up-code:
    type: int
    required: true
  down-code:
    type: int
    required: true
  threshold:
    type: int
    default: 3
    description: Positive minimum net same-axis samples before firing.
  axis-ratio:
    type: int
    default: 2
    description: Positive ratio of net samples to the other axis's total samples.
  left-keycode:
    type: int
    required: true
    description: Encoded ZMK keycode tapped on a leftward swipe.
  right-keycode:
    type: int
    required: true
  up-keycode:
    type: int
    required: true
  down-keycode:
    type: int
    required: true
  three-finger-code:
    type: int
    required: true
    description: Input key code the driver reports while exactly three fingers are down.
  tap-keycode:
    type: int
    default: 0
    description: Encoded ZMK keycode tapped on a three-finger tap; 0 disables taps.
  tap-max-ms:
    type: int
    default: 300
    description: Maximum touch duration, first contact to full release, for a tap.
  tap-max-samples:
    type: int
    default: 2
    description: Maximum three-finger direction samples allowed in a tap.
  click-suppress-ms:
    type: int
    default: 150
    description: After a three-finger touch, drop INPUT_BTN_0/1 events for this long.
```

## dts/bindings/sensor/zmk,battery-voltage-divider-thresholds.yaml
```yaml
# SPDX-License-Identifier: MIT

description: |
  Battery SoC monitoring using a voltage divider, with a custom
  millivolt -> percent curve (vendored in this config; replaces the
  "mv-to-pct-thresholds" property of the cormoran ZMK fork).

compatible: "zmk,battery-voltage-divider-thresholds"

include: voltage-divider.yaml

properties:
  mv-to-pct-thresholds:
    type: array
    required: true
    description: |
      Battery millivolts at evenly spaced charge levels, ascending: the first
      entry is 0 %, the last is 100 % (11 entries = every 10 %).
```

## modules/zmk-input-processor-touch-inertia/dts/bindings/input/processor/input-processor-touch-inertia.yaml
```yaml
description: Touch-release inertia for a relative wheel axis
compatible: "zmk,input-processor-touch-inertia"
include: ip_zero_param.yaml
properties:
  wheel-code:
    type: int
    required: true
  touch-code:
    type: int
    required: true
  tick-ms:
    type: int
    default: 10
    description: Tick interval in milliseconds; zero is treated as one.
  decay-permille:
    type: int
    default: 920
    description: Velocity retention per tick, from 0 through 999.
  stop-threshold-q8:
    type: int
    default: 96
    description: Positive minimum speed in Q8 wheel units per tick.
  ema-new-permille:
    type: int
    default: 250
    description: New sample weight, from 0 through 1000.
```
